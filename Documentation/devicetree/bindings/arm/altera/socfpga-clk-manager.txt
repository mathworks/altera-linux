## Documentation/devicetree/bindings/arm/altera/socfpga-clk-manager.txt
```
Altera SOCFPGA Clock Manager

Required properties:
- compatible : "altr,clk-mgr"
- reg : Should contain 1 register ranges(address and length)

Example:
	 clkmgr@ffd04000 {
		compatible = "altr,clk-mgr";
		reg = <0xffd04000 0x1000>;
	};
```
